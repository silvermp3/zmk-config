## config/boards/shields/cloudsplit36/Kconfig.defconfig
```kconfig
if SHIELD_CLOUDSPLIT36_LEFT || SHIELD_CLOUDSPLIT36_RIGHT

config ZMK_KEYBOARD_NAME
    default "CloudSplit36"

config ZMK_SPLIT
    default y

endif

if SHIELD_CLOUDSPLIT36_LEFT

config ZMK_SPLIT_ROLE_CENTRAL
    default y

endif
```

## config/boards/shields/cloudsplit36/Kconfig.shield
```kconfig
config SHIELD_CLOUDSPLIT36_LEFT
    def_bool $(shields_list_contains,cloudsplit36_left)

config SHIELD_CLOUDSPLIT36_RIGHT
    def_bool $(shields_list_contains,cloudsplit36_right)
```
